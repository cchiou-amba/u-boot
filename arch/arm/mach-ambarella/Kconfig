## arch/arm/mach-ambarella/Kconfig
```kconfig
if ARCH_AMBARELLA

# board/<vendor>/common/* and board/<vendor>/<board>/*
config SYS_VENDOR
	default "ambarella"

# arch/<arch>/cpu/<cpu>/<soc> and mach-<soc>
config SYS_SOC
	default "ambarella"

config ARCH_AMBARELLA_CV28
	def_bool n

config ARCH_AMBARELLA_CV25
	def_bool n

config ARCH_AMBARELLA_CV22
	def_bool n

config ARCH_AMBARELLA_S6LM
	def_bool n

config ARCH_AMBARELLA_CV5
	def_bool n

config ARCH_AMBARELLA_CV3
	def_bool n

config ARCH_AMBARELLA_CV72
	def_bool n

config ARCH_AMBARELLA_CV75
	def_bool n

config ARCH_AMBARELLA_N1_655
	def_bool n

config ARCH_AMBARELLA_CV7
	def_bool n

config AMBA_BOOT_SECONDARY_CORTEX
    bool "Ambarella boot secondary cortex"
    help
        Ambarella boot secondary cortex

config AMBA_BOOT_SECONDARY_CLUSTER
    bool "Ambarella boot multi cluster"
    select AMBA_BOOT_SECONDARY_CORTEX
    help
        Ambarella boot multi cluster

config AMBA_BOOT_SECONDARY_CLUSTER_DEFERRED
    bool "Boot clusters into WFE(deferred)"
    depends on AMBA_BOOT_SECONDARY_CLUSTER

choice
	prompt "Ambarella board select"

config TARGET_S6LM_DEVKIT
	bool "Ambarella S6L devkit"
	select ARCH_AMBARELLA_S6LM
	help
		Ambarella International LP

config TARGET_CV22_DEVKIT
	bool "Ambarella CV22 devkit"
	select ARCH_AMBARELLA_CV22
	help
		Ambarella International LP

config TARGET_CV25_DEVKIT
	bool "Ambarella CV25 devkit"
	select ARCH_AMBARELLA_CV25
	help
		Ambarella International LP

config TARGET_CV28_DEVKIT
	bool "Ambarella CV28 devkit"
	select ARCH_AMBARELLA_CV28
	help
		Ambarella International LP

config TARGET_CV5_DEVKIT
	bool "Ambarella CV5 devkit"
	select ARCH_AMBARELLA_CV5
	help
		Ambarella International LP

config TARGET_CV3_DEVKIT
	bool "Ambarella CV3 devkit"
	select ARCH_AMBARELLA_CV3
	help
		Ambarella International LP

config TARGET_CV3_BUB
	bool "Ambarella CV3 Bring-Up Board"
	select ARCH_AMBARELLA_CV3
	help
		Ambarella International LP

config TARGET_CV72_DEVKIT
	bool "Ambarella CV72 devkit"
	select ARCH_AMBARELLA_CV72
	help
		Ambarella International LP

config TARGET_CV72_COOPER_MINI
	bool "Ambarella CV72 Cooper Mini"
	select ARCH_AMBARELLA_CV72

config TARGET_N1_COOPER_MAX
	bool "Ambarella N1 Cooper Max"
	select ARCH_AMBARELLA_CV3

config TARGET_CV75_DEVKIT
	bool "Ambarella CV75 devkit"
	select ARCH_AMBARELLA_CV75

config TARGET_N1_655_COBRA
	bool "Ambarella N1_655 COBRA"
	select ARCH_AMBARELLA_N1_655

config TARGET_N1_655_COOPER_PRO
	bool "Ambarella N1 655 COOPER PRO"
	select ARCH_AMBARELLA_N1_655

config TARGET_N1_655_DEVKIT
	bool "Ambarella N1 655 DEVKIT"
	select ARCH_AMBARELLA_N1_655

config TARGET_CV7_DEVKIT
	bool "Ambarella CV7 DEVKIT"
	select ARCH_AMBARELLA_CV7

endchoice

#source "board/ambarella/s6lm_devkit/Kconfig"
#source "board/ambarella/cv22_devkit/Kconfig"
#source "board/ambarella/cv25_devkit/Kconfig"
#source "board/ambarella/cv28_devkit/Kconfig"
source "board/ambarella/cv5_devkit/Kconfig"
source "board/ambarella/cv72_devkit/Kconfig"
source "board/ambarella/cv72_cooper_mini/Kconfig"
source "board/ambarella/cv3_devkit/Kconfig"
source "board/ambarella/cv3_bub/Kconfig"
source "board/ambarella/n1_cooper_max/Kconfig"
source "board/ambarella/cv75_devkit/Kconfig"
source "board/ambarella/n1_655_cobra/Kconfig"
source "board/ambarella/n1_655_cooper_pro/Kconfig"
source "board/ambarella/n1_655_devkit/Kconfig"
source "board/ambarella/cv7_devkit/Kconfig"

endif
```

## configs/ambarella_cv22_defconfig
```kconfig
CONFIG_ARM=y
CONFIG_SYS_TEXT_BASE=0x00000000
CONFIG_TARGET_CV22_DEVKIT=y
CONFIG_SYS_CONFIG_NAME="cv22"
# CONFIG_DISPLAY_CPUINFO is not set
# CONFIG_DISPLAY_BOARDINFO is not set
CONFIG_BOARD_EARLY_INIT_F=y
CONFIG_BOARD_LATE_INIT=y
CONFIG_ARCH_AMBARELLA=y

#
# Compatiable with AMBOOT
#
CONFIG_ENABLE_ARM_SOC_BOOT0_HOOK=y

CONFIG_FIT=y
CONFIG_DM=y
CONFIG_OF_CONTROL=y
CONFIG_MULTI_DTB_FIT=y

#
# Memory allocator in board_f.
#  - malloc_simple.c
#
CONFIG_SYS_MALLOC_F_LEN=0x100000

#
# Serial
#
CONFIG_AMBARELLA_SERIAL=y
CONFIG_DM_SERIAL=y

CONFIG_DEBUG_UART=y
CONFIG_DEBUG_UART_BASE=0xe4000000
CONFIG_DEBUG_UART_CLOCK=24000000

#
# Pinctrl
#
CONFIG_PINCTRL=y
CONFIG_PINCTRL_FULL=y
CONFIG_PINCTRL_AMBARELLA=y

#
#GPIO
#
CONFIG_DM_GPIO=y
CONFIG_AMBARELLA_GPIO=y
CONFIG_CMD_GPIO=y
#
# Watchdog
#
CONFIG_WATCHDOG=y
CONFIG_WDT=y
CONFIG_WDT_AMBARELLA=y

#
# NAND media
#
CONFIG_MTD=y
CONFIG_NAND_AMBARELLA=y
CONFIG_MTD_RAW_NAND=y
CONFIG_CMD_MTDPARTS=y

CONFIG_CMD_MTD=y

#
# Regmap
#
CONFIG_REGMAP=y
CONFIG_SYSCON=y

#
# !!! For debug. removed later.
#
CONFIG_LOGLEVEL=8

#
# Fastboot
#
CONFIG_USB_FUNCTION_FASTBOOT=y
CONFIG_FASTBOOT_BUF_SIZE=0x08000000
CONFIG_FASTBOOT_BUF_ADDR=0x10000000

CONFIG_USB=y
CONFIG_USB_GADGET=y
CONFIG_AMBARELLA_UDC=y
CONFIG_DM_USB_GADGET=y
CONFIG_DM_USB=y

CONFIG_USB_GADGET_MANUFACTURER="AMBA"
CONFIG_USB_GADGET_VENDOR_NUM=0x18d1
CONFIG_USB_GADGET_PRODUCT_NUM=0x4ee0

#
# Fastboot flash
#
CONFIG_FASTBOOT_FLASH=y
CONFIG_FASTBOOT_FLASH_NAND=y

#
# ARMV8 spin table
#
CONFIG_ARMV8_MULTIENTRY=y
CONFIG_ARMV8_SPIN_TABLE=y
CONFIG_ARMV8_SET_SMPEN=y


#
# support if, while, for ... in bootcmd
#
CONFIG_HUSH_PARSER=y
```

## configs/ambarella_cv5_defconfig
```kconfig
CONFIG_ARM=y
CONFIG_ARM64=y
# CONFIG_ARM64_SUPPORT_AARCH32 is not set
CONFIG_SYS_TEXT_BASE=0x00000000
CONFIG_NR_DRAM_BANKS=1
CONFIG_TARGET_CV5_DEVKIT=y
CONFIG_SYS_CONFIG_NAME="cv5"
CONFIG_DISTRO_DEFAULTS=y
CONFIG_SUPPORT_RAW_INITRD=y
# CONFIG_DISPLAY_CPUINFO is not set
# CONFIG_DISPLAY_BOARDINFO is not set
CONFIG_BOARD_EARLY_INIT_F=y
CONFIG_BOARD_LATE_INIT=y
CONFIG_ARCH_AMBARELLA=y

#
# Compatiable with AMBOOT
#
CONFIG_ENABLE_ARM_SOC_BOOT0_HOOK=y

CONFIG_FIT=y
CONFIG_DM=y
CONFIG_DM_DEVICE_REMOVE=n
#
# Partition Types
#
CONFIG_PARTITIONS=y
# CONFIG_MAC_PARTITION is not set
CONFIG_DOS_PARTITION=y
CONFIG_ISO_PARTITION=y
# CONFIG_AMIGA_PARTITION is not set
CONFIG_EFI_PARTITION=y
CONFIG_EFI_PARTITION_ENTRIES_NUMBERS=128
CONFIG_EFI_PARTITION_ENTRIES_OFF=0
CONFIG_PARTITION_UUIDS=y
CONFIG_PARTITION_TYPE_GUID=y
CONFIG_SUPPORT_OF_CONTROL=y
CONFIG_DTC=y
CONFIG_OF_CONTROL=y
CONFIG_MULTI_DTB_FIT=y
#
# Memory allocator in board_f.
#  - malloc_simple.c
#
CONFIG_SYS_MALLOC_F_LEN=0x100000

#
# Serial
#
CONFIG_AMBARELLA_SERIAL=y
CONFIG_DM_SERIAL=y

CONFIG_DEBUG_UART=y
CONFIG_DEBUG_UART_BASE=0x20e4000000
CONFIG_DEBUG_UART_CLOCK=24000000

#
# Pinctrl
#
CONFIG_PINCTRL=y
CONFIG_PINCTRL_FULL=y
CONFIG_PINCTRL_AMBARELLA=y

#
#GPIO
#
CONFIG_DM_GPIO=y
CONFIG_AMBARELLA_GPIO=y
CONFIG_CMD_GPIO=y

#
# I2C
#
CONFIG_SYS_I2C_AMBARELLA=y
CONFIG_DM_I2C=y
CONFIG_CMD_I2C=y

#
# Watchdog
#
CONFIG_WATCHDOG=y
CONFIG_WDT=y
CONFIG_WDT_AMBARELLA=y

#
# ETHERNET
#
#CONFIG_PHY_MICREL=y
#CONFIG_PHY_MICREL_KSZ90X1=y
CONFIG_PHY_REALTEK=y
CONFIG_DM_ETH=y
CONFIG_RGMII=y
CONFIG_ETH_AMBARELLA=y
CONFIG_CMD_MII=y
CONFIG_CMD_PING=y
CONFIG_NET_RANDOM_ETHADDR=y
CONFIG_CMD_NET=y
CONFIG_CMD_SYSBOOT=y

#
# NAND media
#
CONFIG_MTD=y
CONFIG_NAND_AMBARELLA=y
CONFIG_MTD_RAW_NAND=y
CONFIG_CMD_MTDPARTS=y
CONFIG_CMD_MTD=y

#
# MMC media
#
CONFIG_DM_MMC=y
CONFIG_MMC_SDHCI=y
CONFIG_MMC_SDHCI_AMBARELLA=y
CONFIG_CMD_MMC=y




#
# Regmap
#
CONFIG_REGMAP=y
CONFIG_SYSCON=y

#
# !!! For debug. removed later.
#
CONFIG_LOGLEVEL=8

#
# Fastboot
#
CONFIG_USB_FUNCTION_FASTBOOT=y
CONFIG_FASTBOOT_BUF_SIZE=0x08000000
CONFIG_FASTBOOT_BUF_ADDR=0x10000000

CONFIG_USB=y
CONFIG_USB_GADGET=y
CONFIG_AMBARELLA_UDC=y
CONFIG_DM_USB_GADGET=y
CONFIG_DM_USB=y

CONFIG_USB_GADGET_MANUFACTURER="AMBA"
CONFIG_USB_GADGET_VENDOR_NUM=0x18d1
CONFIG_USB_GADGET_PRODUCT_NUM=0x4ee0

#
# Fastboot
#
CONFIG_FASTBOOT_FLASH=y

# Fastboot flash
CONFIG_FASTBOOT_FLASH_NAND=y

############################################
# Fastboot eMMC
#
#CONFIG_FASTBOOT_FLASH_MMC_DEV=0
#CONFIG_FASTBOOT_MMC_BOOT_SUPPORT=y
#CONFIG_FASTBOOT_MMC_BOOT1_NAME="mmc0boot0"

#
# eMMC boot config
#
#CONFIG_SUPPORT_EMMC_BOOT=y
CONFIG_CMD_GPT=y
CONFIG_CMD_GPT_RENAME=y
############################################
#
# ARMV8 spin table
#
CONFIG_ARMV8_MULTIENTRY=y
CONFIG_ARMV8_SPIN_TABLE=y

#
# support if, while, for ... in bootcmd
#
CONFIG_HUSH_PARSER=y

#
# cmd
#
CONFIG_CMD_DM=y

#
# fs
CONFIG_FS_BTRFS=y
CONFIG_FS_EXT4=y
CONFIG_EXT4_WRITE=y
CONFIG_FS_FAT=y
CONFIG_FAT_WRITE=y
CONFIG_CMD_FAT=y
CONFIG_CMD_BTRFS=y
CONFIG_CMD_EXT4=y
CONFIG_CMD_EXT4_WRITE=y
CONFIG_CMD_FS_GENERIC=y

#
# env
#
CONFIG_ENV_SIZE=0x20000
CONFIG_ENV_OFFSET=0x200000
CONFIG_ENV_OVERWRITE=y
CONFIG_ENV_IS_IN_NAND=y
CONFIG_SYS_RELOC_GD_ENV_ADDR=y

#
#
#
CONFIG_OF_SYSTEM_SETUP=y
```

## configs/ambarella_cv72_cooper_mini_defconfig
```kconfig
CONFIG_ARM=y
CONFIG_ENABLE_ARM_SOC_BOOT0_HOOK=y
CONFIG_ARCH_AMBARELLA=y
CONFIG_SYS_TEXT_BASE=0x00000000
CONFIG_SYS_MALLOC_F_LEN=0x100000
CONFIG_NR_DRAM_BANKS=1
CONFIG_ENV_SIZE=0x20000
CONFIG_ENV_OFFSET=0x140000
CONFIG_DM_GPIO=y
CONFIG_DEBUG_UART_BASE=0xffe4000000
CONFIG_DEBUG_UART_CLOCK=24000000
CONFIG_ARMV8_MULTIENTRY=y
CONFIG_ARMV8_SPIN_TABLE=y
CONFIG_TARGET_CV72_COOPER_MINI=y
CONFIG_DEBUG_UART=y
CONFIG_DISTRO_DEFAULTS=y
CONFIG_FIT=y
CONFIG_OF_SYSTEM_SETUP=y
CONFIG_LOGLEVEL=8
CONFIG_BOARD_LATE_INIT=y
# CONFIG_DISPLAY_CPUINFO is not set
CONFIG_BOARD_EARLY_INIT_F=y
CONFIG_CMD_BOOTZ=y
CONFIG_CMD_BOOTMENU=y
CONFIG_CMD_NVEDIT_EFI=y
CONFIG_CMD_NVEDIT_INFO=y
CONFIG_CMD_NVEDIT_LOAD=y
CONFIG_CMD_DM=y
CONFIG_CMD_GPIO=y
CONFIG_CMD_GPT=y
CONFIG_CMD_GPT_RENAME=y
CONFIG_CMD_I2C=y
CONFIG_CMD_MMC=y
CONFIG_CMD_USB=y
CONFIG_CMD_EFIDEBUG=y
CONFIG_CMD_UUID=y
CONFIG_CMD_BTRFS=y
CONFIG_CMD_EXT4_WRITE=y
CONFIG_CMD_ZFS=y
CONFIG_PARTITION_TYPE_GUID=y
CONFIG_OF_CONTROL=y
CONFIG_OF_EMBED=y
CONFIG_MULTI_DTB_FIT=y
CONFIG_ENV_OVERWRITE=y
CONFIG_ENV_IS_IN_MMC=y
CONFIG_SYS_RELOC_GD_ENV_ADDR=y
CONFIG_NET_RANDOM_ETHADDR=y
CONFIG_DM=y
CONFIG_REGMAP=y
CONFIG_SYSCON=y
CONFIG_USB_FUNCTION_FASTBOOT=y
CONFIG_FASTBOOT_BUF_ADDR=0x10000000
CONFIG_FASTBOOT_BUF_SIZE=0x08000000
CONFIG_FASTBOOT_FLASH=y
CONFIG_FASTBOOT_FLASH_MMC_DEV=0
CONFIG_FASTBOOT_MMC_BOOT_SUPPORT=y
CONFIG_DM_I2C=y
CONFIG_SYS_I2C_AMBARELLA=y
CONFIG_DM_MMC=y
CONFIG_SUPPORT_EMMC_BOOT=y
CONFIG_MMC_SDHCI=y
CONFIG_MMC_SDHCI_AMBARELLA=y
CONFIG_PHY_REALTEK=y
CONFIG_DM_ETH=y
CONFIG_ETH_AMBARELLA=y
CONFIG_RGMII=y
CONFIG_PINCTRL=y
CONFIG_PINCTRL_AMBARELLA=y
CONFIG_DM_SERIAL=y
CONFIG_AMBARELLA_SERIAL=y
CONFIG_USB=y
CONFIG_DM_USB=y
CONFIG_DM_USB_GADGET=y
CONFIG_USB_XHCI_HCD=y
CONFIG_USB_CDNS3=y
CONFIG_USB_CDNS3_HOST=y
CONFIG_USB_GADGET=y
CONFIG_USB_GADGET_MANUFACTURER="AMBA"
CONFIG_USB_GADGET_VENDOR_NUM=0x18d1
CONFIG_USB_GADGET_PRODUCT_NUM=0x4ee0
CONFIG_AMBARELLA_UDC=y
CONFIG_WDT=y
CONFIG_WDT_AMBARELLA=y


#
# SPINOR media
#
CONFIG_MTD=y
CONFIG_CMD_MTDPARTS=y
CONFIG_CMD_MTD=y

CONFIG_DM_MTD=y
CONFIG_SPI=y
CONFIG_DM_SPI=y
CONFIG_SPI_MTD=y
CONFIG_SPI_FLASH=y
CONFIG_SPI_FLASH_MTD=y
CONFIG_SPI_MEM=y
CONFIG_DM_SPI_FLASH=y
CONFIG_SPI_FLASH_WINBOND=y
CONFIG_AMBARELLA_SPINOR=y
CONFIG_SPI_FLASH_USE_4K_SECTORS=y
```

## configs/ambarella_cv72tz_defconfig
```kconfig
CONFIG_ARM=y
CONFIG_ENABLE_ARM_SOC_BOOT0_HOOK=y
# CONFIG_ARM64_SUPPORT_AARCH32 is not set
CONFIG_ARCH_AMBARELLA=y
CONFIG_SYS_TEXT_BASE=0x01C00000
CONFIG_SYS_MALLOC_F_LEN=0x100000
CONFIG_NR_DRAM_BANKS=1
CONFIG_ENV_SIZE=0x20000
CONFIG_ENV_OFFSET=0xE0000
CONFIG_DM_GPIO=y
CONFIG_DEBUG_UART_BASE=0xffe4000000
CONFIG_DEBUG_UART_CLOCK=24000000
CONFIG_ARMV8_MULTIENTRY=y
CONFIG_ARMV8_SPIN_TABLE=y
CONFIG_TARGET_CV72_DEVKIT=y
CONFIG_DEBUG_UART=y
CONFIG_DISTRO_DEFAULTS=y
CONFIG_OF_SYSTEM_SETUP=y
CONFIG_LOGLEVEL=8
CONFIG_BOARD_LATE_INIT=y
# CONFIG_DISPLAY_CPUINFO is not set
# CONFIG_DISPLAY_BOARDINFO is not set
CONFIG_BOARD_EARLY_INIT_F=y
CONFIG_CMD_DM=y
CONFIG_CMD_GPIO=y
CONFIG_CMD_GPT=y
CONFIG_CMD_GPT_RENAME=y
CONFIG_CMD_MMC=y
CONFIG_CMD_MTD=y
CONFIG_CMD_USB=y
CONFIG_CMD_BTRFS=y
CONFIG_CMD_EXT4_WRITE=y
CONFIG_CMD_MTDPARTS=y
CONFIG_PARTITION_TYPE_GUID=y
CONFIG_OF_CONTROL=y
CONFIG_OF_BOARD=y
CONFIG_ENV_OVERWRITE=y
CONFIG_ENV_IS_IN_NAND=y
CONFIG_SYS_RELOC_GD_ENV_ADDR=y
CONFIG_NET_RANDOM_ETHADDR=y
CONFIG_DM=y
# CONFIG_DM_DEVICE_REMOVE is not set
CONFIG_REGMAP=y
CONFIG_SYSCON=y
CONFIG_USB_FUNCTION_FASTBOOT=y
CONFIG_FASTBOOT_BUF_ADDR=0x10000000
CONFIG_FASTBOOT_BUF_SIZE=0x08000000
CONFIG_FASTBOOT_FLASH=y
CONFIG_FASTBOOT_FLASH_NAND=y
CONFIG_DM_MMC=y
CONFIG_MMC_SDHCI=y
CONFIG_MMC_SDHCI_AMBARELLA=y
CONFIG_MTD=y
CONFIG_MTD_RAW_NAND=y
CONFIG_NAND_AMBARELLA=y
CONFIG_PHY_REALTEK=y
CONFIG_DM_ETH=y
CONFIG_DWC_ETH_QOS=y
CONFIG_DWC_ETH_QOS_AMBARELLA=y
CONFIG_RGMII=y
CONFIG_PINCTRL=y
CONFIG_PINCTRL_AMBARELLA=y
CONFIG_DM_SERIAL=y
CONFIG_AMBARELLA_SERIAL=y
CONFIG_USB=y
CONFIG_DM_USB=y
CONFIG_DM_USB_GADGET=y
CONFIG_USB_XHCI_HCD=y
CONFIG_USB_CDNS3=y
CONFIG_USB_CDNS3_HOST=y
# CONFIG_USB_CDNS3_TI is not set
CONFIG_USB_GADGET=y
CONFIG_USB_GADGET_MANUFACTURER="AMBA"
CONFIG_USB_GADGET_VENDOR_NUM=0x18d1
CONFIG_USB_GADGET_PRODUCT_NUM=0x4ee0
CONFIG_AMBARELLA_UDC=y
CONFIG_SHA1=y
CONFIG_SHA256=y
CONFIG_MD5=y
```

## configs/ambarella_n1_655_cooper_pro_clusters_defconfig
```kconfig
CONFIG_ARM=y
CONFIG_ENABLE_ARM_SOC_BOOT0_HOOK=y
# CONFIG_ARM64_SUPPORT_AARCH32 is not set
CONFIG_ARCH_AMBARELLA=y
CONFIG_SYS_TEXT_BASE=0x00000000
CONFIG_SYS_MALLOC_F_LEN=0x100000
CONFIG_NR_DRAM_BANKS=1
CONFIG_ENV_SIZE=0x20000
CONFIG_ENV_OFFSET=0xA00000
CONFIG_DM_GPIO=y
CONFIG_DEBUG_UART_BASE=0xffe4000000
CONFIG_DEBUG_UART_CLOCK=24000000
CONFIG_ARMV8_MULTIENTRY=y
CONFIG_ARMV8_SPIN_TABLE=y
CONFIG_AMBA_BOOT_SECONDARY_CLUSTER=y
CONFIG_TARGET_N1_655_COOPER_PRO=y
CONFIG_DEFAULT_DEVICE_TREE="ambarella-cv3"
CONFIG_DEBUG_UART=y
CONFIG_DISTRO_DEFAULTS=y
CONFIG_FIT=y
CONFIG_OF_SYSTEM_SETUP=y
CONFIG_LOGLEVEL=8
CONFIG_BOARD_LATE_INIT=y
# CONFIG_DISPLAY_CPUINFO is not set
# CONFIG_DISPLAY_BOARDINFO is not set
CONFIG_BOARD_EARLY_INIT_F=y
CONFIG_CMD_DM=y
CONFIG_CMD_GPIO=y
CONFIG_CMD_GPT=y
CONFIG_CMD_GPT_RENAME=y
CONFIG_CMD_I2C=y
CONFIG_CMD_MMC=y
CONFIG_CMD_USB=y
CONFIG_CMD_BTRFS=y
CONFIG_CMD_EXT4_WRITE=y
CONFIG_PARTITION_TYPE_GUID=y
CONFIG_OF_CONTROL=y
CONFIG_OF_EMBED=y
CONFIG_OF_LIST=""
CONFIG_MULTI_DTB_FIT=y
CONFIG_ENV_OVERWRITE=y
CONFIG_ENV_IS_IN_MMC=y
CONFIG_SYS_RELOC_GD_ENV_ADDR=y
CONFIG_NET_RANDOM_ETHADDR=y
CONFIG_DM=y
CONFIG_REGMAP=y
CONFIG_SYSCON=y
CONFIG_DM_I2C=y
CONFIG_SYS_I2C_AMBARELLA=y
CONFIG_DM_MMC=y
CONFIG_SUPPORT_EMMC_BOOT=y
CONFIG_MMC_SDHCI=y
CONFIG_MMC_SDHCI_AMBARELLA=y
CONFIG_PHY_REALTEK=y
CONFIG_DM_ETH=y
CONFIG_ETH_AMBARELLA=y
CONFIG_RGMII=y
CONFIG_PINCTRL=y
CONFIG_PINCTRL_AMBARELLA=y
CONFIG_DM_SERIAL=y
CONFIG_AMBARELLA_SERIAL=y
CONFIG_USB=y
CONFIG_DM_USB=y
CONFIG_DM_USB_GADGET=y
CONFIG_USB_XHCI_HCD=y
CONFIG_USB_CDNS3=y
CONFIG_USB_CDNS3_HOST=y
# CONFIG_USB_CDNS3_TI is not set
CONFIG_USB_GADGET=y
CONFIG_USB_GADGET_MANUFACTURER="AMBA"
CONFIG_USB_GADGET_VENDOR_NUM=0x18d1
CONFIG_USB_GADGET_PRODUCT_NUM=0x4ee0
CONFIG_AMBARELLA_UDC=y
CONFIG_WDT=y
CONFIG_WDT_AMBARELLA=y
```

## drivers/phy/cadence/Kconfig
```kconfig
config PHY_CADENCE_TORRENT
	tristate "Cadence Torrent PHY Driver"
	depends on DM_RESET
	help
	  Enable this to support the Cadence Torrent PHY driver
```
